## meta-bb-provision/conf/layer.conf
```bitbake
# -*- mode: Conf; -*-
# We have a conf and classes directory, add to BBPATH
BBPATH .= ":${LAYERDIR}"

# We have recipes-* directories, add to BBFILES
BBFILES += "${LAYERDIR}/recipes-*/*/*.bb \
            ${LAYERDIR}/recipes-*/*/*.bbappend"

BBFILE_COLLECTIONS += "meta-bb-provision"
BBFILE_PATTERN_meta-bb-provision = "^${LAYERDIR}/"
BBFILE_PRIORITY_meta-bb-provision = "7"

LAYERDEPENDS_meta-bb-provision += "meta-aws"

LAYERSERIES_COMPAT_meta-bb-provision = "kirkstone"
```
